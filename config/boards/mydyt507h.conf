## patch/u-boot/v2024.01/board_okt507c/okt507c_defconfig
```kconfig
CONFIG_ARM=y
CONFIG_ARCH_SUNXI=y
CONFIG_DEFAULT_DEVICE_TREE="sun50i-t507-okt507c"
CONFIG_SPL=y

CONFIG_SYS_CLK_FREQ=1008000000
CONFIG_MACH_SUN50I_H616=y

CONFIG_DRAM_CLK=672
CONFIG_SUNXI_DRAM_H616_DDR3_1333=y
CONFIG_DRAM_SUN50I_H616_DX_ODT=0x08080808
CONFIG_DRAM_SUN50I_H616_DX_DRI=0x0e0e0e0e
CONFIG_DRAM_SUN50I_H616_CA_DRI=0x0e0e
CONFIG_DRAM_SUN50I_H616_TPR6=0x33808080
CONFIG_DRAM_SUN50I_H616_TPR10=0x00f93336

CONFIG_MMC0_CD_PIN="PF6"
#CONFIG_MMC_SUNXI_SLOT_EXTRA=2

CONFIG_R_I2C_ENABLE=y
CONFIG_SPL_I2C=y
CONFIG_SPL_SYS_I2C_LEGACY=y
CONFIG_SYS_I2C_MVTWSI=y
CONFIG_SYS_I2C_SLAVE=0x7f
CONFIG_SYS_I2C_SPEED=400000

CONFIG_SUPPORT_EMMC_BOOT=y
CONFIG_AXP858_POWER=y
CONFIG_USB_EHCI_HCD=y
#CONFIG_USB_OHCI_HCD=y

#CONFIG_USB_MUSB_GADGET=y
#CONFIG_USB_FUNCTION_MASS_STORAGE=y

CONFIG_USE_PREBOOT=y
CONFIG_PREBOOT=" "

CONFIG_CMD_FAT=y
CONFIG_CMD_EXT2=y
CONFIG_CMD_BTRFS=y
CONFIG_CMD_EXT4_WRITE=y

CONFIG_DOS_PARTITION=y
CONFIG_SPL_DOS_PARTITION=y
CONFIG_SPL_EFI_PARTITION=y
CONFIG_SPL_PARTITIONS=y
CONFIG_SPL_EFI_PARTITION=y
```
